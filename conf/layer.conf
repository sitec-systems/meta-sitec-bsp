## conf/layer.conf
```bitbake
# We have a conf and classes directory, add to BBPATH
BBPATH .= ":${LAYERDIR}"

# We have recipes-* directories, add to BBFILES
BBFILES += "${LAYERDIR}/recipes-*/*/*.bb \
${LAYERDIR}/recipes-*/*/*.bbappend"

BBFILE_COLLECTIONS += "sitec-bsp"
BBFILE_PATTERN_sitec-bsp = "^${LAYERDIR}/"
BBFILE_PRIORITY_sitec-bsp = "10"
LAYERVERSION_sitec-bsp = "1"
```
